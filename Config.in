## Config.in
```kconfig
menu "Custom packages"

source "$NERVES_DEFCONFIG_DIR/package/libical3/Config.in"

endmenu
```

## package/libical3/Config.in
```kconfig
config BR2_PACKAGE_LIBICAL3
    bool "libical3"
    help
        iCalendar protocol

        https://github.com/libical/libical
```
